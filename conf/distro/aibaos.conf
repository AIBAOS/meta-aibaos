## conf/distro/aibaos.conf
```bitbake
DISTRO_NAME = "iBaOS"
DISTRO_VERSION = "0.0.1"
DISTRO_CODENAME = "core-alpha"
SDK_VENDOR = "-aibaos"
MAINTAINER = "AIBAOS Team <team@aibaos.org>"

INIT_MANAGER = "systemd"
VIRTUAL-RUNTIME_init_manager = "systemd"
VIRTUAL-RUNTIME_initscripts = "systemd-compat-units"
DISTRO_FEATURES:append = " systemd"
DISTRO_FEATURES_BACKFILL_CONSIDERED:append = " sysvinit"
```

## conf/layer.conf
```bitbake
# We have a conf and classes directory, add to BBPATH
BBPATH .= ":${LAYERDIR}"

# We have recipes-* directories, add to BBFILES
BBFILES += "${LAYERDIR}/recipes-*/*/*.bb \
            ${LAYERDIR}/recipes-*/*/*.bbappend"

BBFILE_COLLECTIONS += "meta-aibaos"
BBFILE_PATTERN_meta-aibaos = "^${LAYERDIR}/"
BBFILE_PRIORITY_meta-aibaos = "6"

LAYERDEPENDS_meta-aibaos = "core"
LAYERSERIES_COMPAT_meta-aibaos = "scarthgap"
```
